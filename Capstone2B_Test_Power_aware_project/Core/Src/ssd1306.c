/**
  ******************************************************************************
  * @file    ssd1306.c
  * @brief   SSD1306 OLED 128x64 I2C Driver — Lightweight
  *          Fixed: timeout + hardware I2C bus recovery
  ******************************************************************************
  */

#include "ssd1306.h"

#define I2C_TIMEOUT  50

/* Defined in power_monitor.c — hardware bus reset */
extern void i2c_bus_reset(void);

/* ---- Private Variables ---- */
static I2C_HandleTypeDef *ssd1306_i2c;
static uint8_t ssd1306_buffer[SSD1306_WIDTH * SSD1306_HEIGHT / 8];
static uint8_t cursor_x = 0;
static uint8_t cursor_y = 0;

/* ---- 5x7 Font (ASCII 32-126) ---- */
static const uint8_t font5x7[][5] = {
    {0x00,0x00,0x00,0x00,0x00},
    {0x00,0x00,0x5F,0x00,0x00},
    {0x00,0x07,0x00,0x07,0x00},
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    {0x08,0x08,0x2A,0x1C,0x08},
};

/* ---- I2C Command/Data Helpers ---- */

static void ssd1306_write_cmd(uint8_t cmd)
{
    uint8_t buf[2] = {0x00, cmd};
    if (HAL_I2C_Master_Transmit(ssd1306_i2c, SSD1306_I2C_ADDR, buf, 2, I2C_TIMEOUT) != HAL_OK)
    {
        i2c_bus_reset();
    }
}

/* ---- Public Functions ---- */

void ssd1306_init(I2C_HandleTypeDef *hi2c)
{
    ssd1306_i2c = hi2c;

    HAL_Delay(100);

    ssd1306_write_cmd(0xAE);
    ssd1306_write_cmd(0xD5);
    ssd1306_write_cmd(0x80);
    ssd1306_write_cmd(0xA8);
    ssd1306_write_cmd(0x3F);
    ssd1306_write_cmd(0xD3);
    ssd1306_write_cmd(0x00);
    ssd1306_write_cmd(0x40);
    ssd1306_write_cmd(0x8D);
    ssd1306_write_cmd(0x14);
    ssd1306_write_cmd(0x20);
    ssd1306_write_cmd(0x00);
    ssd1306_write_cmd(0xA1);
    ssd1306_write_cmd(0xC8);
    ssd1306_write_cmd(0xDA);
    ssd1306_write_cmd(0x12);
    ssd1306_write_cmd(0x81);
    ssd1306_write_cmd(0xCF);
    ssd1306_write_cmd(0xD9);
    ssd1306_write_cmd(0xF1);
    ssd1306_write_cmd(0xDB);
    ssd1306_write_cmd(0x40);
    ssd1306_write_cmd(0xA4);
    ssd1306_write_cmd(0xA6);
    ssd1306_write_cmd(0xAF);

    ssd1306_clear();
    ssd1306_update();
}

void ssd1306_clear(void)
{
    memset(ssd1306_buffer, 0x00, sizeof(ssd1306_buffer));
    cursor_x = 0;
    cursor_y = 0;
}

void ssd1306_update(void)
{
    ssd1306_write_cmd(0x21);
    ssd1306_write_cmd(0x00);
    ssd1306_write_cmd(0x7F);

    ssd1306_write_cmd(0x22);
    ssd1306_write_cmd(0x00);
    ssd1306_write_cmd(0x07);

    for (uint16_t i = 0; i < sizeof(ssd1306_buffer); i += 16)
    {
        uint8_t data[17];
        data[0] = 0x40;
        uint16_t remaining = sizeof(ssd1306_buffer) - i;
        uint16_t chunk = (remaining < 16) ? remaining : 16;
        memcpy(&data[1], &ssd1306_buffer[i], chunk);
        if (HAL_I2C_Master_Transmit(ssd1306_i2c, SSD1306_I2C_ADDR, data, chunk + 1, I2C_TIMEOUT) != HAL_OK)
        {
            i2c_bus_reset();
            return;
        }
    }
}

void ssd1306_set_cursor(uint8_t x, uint8_t y)
{
    cursor_x = x;
    cursor_y = y;
}

void ssd1306_write_char(char ch)
{
    if (ch < 32 || ch > 126) ch = '?';

    if (cursor_x + 6 > SSD1306_WIDTH)
    {
        cursor_x = 0;
        cursor_y += 8;
    }
    if (cursor_y + 8 > SSD1306_HEIGHT)
    {
        return;
    }

    uint8_t idx = ch - 32;
    uint8_t page = cursor_y / 8;

    for (uint8_t col = 0; col < 5; col++)
    {
        ssd1306_buffer[page * SSD1306_WIDTH + cursor_x + col] = font5x7[idx][col];
    }
    ssd1306_buffer[page * SSD1306_WIDTH + cursor_x + 5] = 0x00;

    cursor_x += 6;
}

void ssd1306_write_string(const char *str)
{
    while (*str)
    {
        ssd1306_write_char(*str);
        str++;
    }
}

void ssd1306_display_on(void)
{
    ssd1306_write_cmd(0x8D);
    ssd1306_write_cmd(0x14);
    ssd1306_write_cmd(0xAF);
}

void ssd1306_display_off(void)
{
    ssd1306_write_cmd(0xAE);
    ssd1306_write_cmd(0x8D);
    ssd1306_write_cmd(0x10);
}
